## conf/distro/ov585-openstlinux-weston.conf
```bitbake
#@NAME: openstlinux-weston
#@DESCRIPTION: OpenSTLinux featuring Weston/Wayland (with GPLv3 software)

require include/ov585-cargt-default-distro-rules.inc
require include/ov585-cargt-default-distro-providers.inc
require include/ov585.inc

# =========================================================================
# Distribution definition for: st-openstlinux-weston-
# =========================================================================
DISTRO = "cargt-openstlinux-weston"
DISTRO_NAME = "Cargt OpenSTLinux - Weston - (A Yocto Project Based Distro)"

# =========================================================================
# DISTRO features
# =========================================================================
DISTRO_FEATURES:append = " opengl systemd networkmanager"
DISTRO_FEATURES:remove = " x11 "
# with X11
#PREFERRED_PROVIDER_virtual/xserver = "${@bb.utils.contains('DISTRO_FEATURES', 'x11 wayland', 'xwayland', 'xserver-xorg', d)}"

NETWORK_MANAGER = "networkmanager"
RDEPENDS:packagegroup-core-tools-testapps:remove = "connman-tools connman-tests connman-client "

DISTRO_FEATURES:append = " gplv3 "

# activate GPU Vulkan & opencl
DISTRO_FEATURES:append = " ${@bb.utils.filter('MACHINE_FEATURES', 'vulkan opencl', d)} "

include conf/distro/include/cargt-base.inc
include conf/distro/include/cargt-preferred-env.inc
```
